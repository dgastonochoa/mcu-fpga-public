## mcu/config/simpleriscv-led_blink_c_defconfig
```kconfig
CONFIG_ARCH=riscv
CONFIG_SOC=simpleriscv
CONFIG_APP_NAME=led_blink_c
CONFIG_EXTRA_BUILD_DEFS=-DGEN_DISSAS_TXT=y
```

## mcu/config/simpleriscv-test_app_defconfig
```kconfig
CONFIG_ARCH=riscv
CONFIG_SOC=simpleriscv
CONFIG_APP_NAME=test_app
CONFIG_EXTRA_BUILD_DEFS=-DGEN_DISSAS_TXT=y
```

## mcu/config/tm4c123g-spi_reader_defconfig
```kconfig
CONFIG_ARCH=arm
CONFIG_SOC=cortex-m4
CONFIG_APP_NAME=spi_reader
CONFIG_EXTRA_BUILD_DEFS=-DTIVA_SDK=y
```

## mcu/config/tm4c123g-spi_slave_echo_defconfig
```kconfig
CONFIG_ARCH=arm
CONFIG_SOC=cortex-m4
CONFIG_APP_NAME=spi_slave_echo
CONFIG_EXTRA_BUILD_DEFS=-DTIVA_SDK=y
```
